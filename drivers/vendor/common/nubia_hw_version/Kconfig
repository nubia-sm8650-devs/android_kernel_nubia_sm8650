## drivers/vendor/common/nubia_hw_version/Kconfig
```kconfig
################nubia hw_version config start################
config NUBIA_HW_VERSION
	tristate "NUBIA HW VERSION"
	default n
	help
	  NUBIA HW VERSION

config NUBIA_HW_CONFIG_BY_GPIO
	bool "NUBIA HW CONFIG BY GPIO"
	depends on NUBIA_HW_VERSION
	default n
	help
		NUBIA HW CONFIG BY GPIO
```
